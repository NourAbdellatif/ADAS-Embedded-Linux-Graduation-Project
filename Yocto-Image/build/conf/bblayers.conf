## Yocto-Image/build/conf/bblayers.conf
```bitbake
# POKY_BBLAYERS_CONF_VERSION is increased each time build/conf/bblayers.conf
# changes incompatibly
POKY_BBLAYERS_CONF_VERSION = "2"

BBPATH = "${TOPDIR}"
BBFILES ?= ""

BBLAYERS ?= " \
  /home/hussam/poky/meta \
  /home/hussam/poky/meta-poky \
  /home/hussam/poky/meta-yocto-bsp \
  /home/hussam/poky/meta-raspberrypi \
  /home/hussam/poky/meta-mylayer \
  /home/hussam/poky/meta-openembedded/meta-oe \
  /home/hussam/poky/meta-openembedded/meta-python \
  /home/hussam/poky/meta-openembedded/meta-networking \
  /home/hussam/poky/meta-atmel \
  /home/hussam/poky/meta-openembedded/meta-multimedia \
  "
```

## Yocto-Image/meta-mylayer/conf/distro/mydistro.conf
```bitbake
#Distro Layer Configuration
require conf/distro/poky.conf
DISTRO = "mydistro"
DISTRO_NAME = "MyDistro-Hussam"
DISTRO_VERSION = "1.0"
DISTRO_CODENAME = "codename"
SDK_VENDOR = "-mydistro"
SDK_VERSION = "${DISTRO_VERSION}"
MAINTAINER = "hussam@mydistro.com"
TARGET_VENDOR = "-mydistro"

#Use systemd as init manager
DISTRO_FEATURES += "systemd wifi opengl fbdev"
VIRTUAL-RUNTIME_init_manager = "systemd"
VIRTUAL-RUNTIME_initscripts = "systemd-compat-units"
DISTRO_FEATURES_BACKFILL_CONSIDERED += "sysvinit"
DISTRO_FEATURES:append = " x11 wayland pam"
#DISTRO_FEATURES:remove = " x11"

EXTRA_IMAGE_FEATURES:append = " package-management"



#Set GPU Memory to 128 MB
GPU_MEM = "128"

#Enable VC4GRAPHICS
#VC4GRAPHICS = "1"

#HDMI_GROUP = "1"

# 1080p 60 Hz Screen
#HDMI_MODE = "16"

VIDEO_CAMERA = "1"
RASPBERRYPI_CAMERA_V2 = "1"
ENABLE_DWC2_HOST = "1"
RPI_EXTRA_CONFIG = ' \n \
max_usb_current=1 \n \
hdmi_group=2 \n \
hdmi_mode=87 \n \
hdmi_cvt 1024 600 60 6 0 0 0 \n \
hdmi_force_hotplug=1 \n \
dtoverlay=vc4-fkms-v3d \n \
    '
```

## Yocto-Image/meta-mylayer/conf/layer.conf
```bitbake
# We have a conf and classes directory, add to BBPATH
BBPATH .= ":${LAYERDIR}"

# We have recipes-* directories, add to BBFILES
BBFILES += "${LAYERDIR}/recipes-*/*/*.bb \
            ${LAYERDIR}/recipes-*/*/*.bbappend"

BBFILE_COLLECTIONS += "meta-mylayer"
BBFILE_PATTERN_meta-mylayer = "^${LAYERDIR}/"
BBFILE_PRIORITY_meta-mylayer = "6"

LAYERDEPENDS_meta-mylayer = "core"
LAYERSERIES_COMPAT_meta-mylayer = "kirkstone langdale dunfell"
```
